## zephyr-workspace/firmware/boards/combat_robot/Kconfig.combat_robot
```kconfig
# Copyright (c) 2024 Dan Collins

config BOARD_COMBAT_ROBOT
	select SOC_STM32L412XX
```

## zephyr-workspace/firmware/boards/combat_robot/Kconfig.defconfig
```kconfig
# Combat Robot board configuration

# Copyright (c) 2024 Dan Collins

if BOARD_COMBAT_ROBOT

config SPI_STM32_INTERRUPT
	default y
	depends on SPI

endif # BOARD_COMBAT_ROBOT
```

## zephyr-workspace/firmware/boards/combat_robot/board.yml
```yaml
board:
  name: combat_robot
  full_name: Combat Robot
  vendor: dancollins
  socs:
    - name: stm32l412xx
```

## zephyr-workspace/firmware/boards/combat_robot/combat_robot_defconfig
```kconfig
# Enable MPU
CONFIG_ARM_MPU=y

# Enable HW stack protection
CONFIG_HW_STACK_PROTECTION=y

CONFIG_GPIO=y
CONFIG_SERIAL=y
CONFIG_PWM=y
CONFIG_I2C=y

CONFIG_CONSOLE=y

# USB
CONFIG_USB_DEVICE_STACK=y
CONFIG_USB_DEVICE_PRODUCT="Zephyr CDC ACM"
CONFIG_USB_DEVICE_VID=0x1915
CONFIG_USB_DEVICE_PID=0xdc00
CONFIG_USB_DEVICE_INITIALIZE_AT_BOOT=y

# Flash memory
CONFIG_FLASH=y
CONFIG_FLASH_MAP=y

CONFIG_SPI=y
CONFIG_SPI_NOR=y
CONFIG_SPI_NOR_SFDP_DEVICETREE=n
```

## zephyr-workspace/firmware/drivers/misc/csrf/Kconfig
```kconfig
menuconfig DAN_CSRF
    bool "Opito HUB75 Controller Driver"
    default y
    depends on DT_HAS_DAN_CSRF_ENABLED
    select SERIAL
    select RING_BUFFER
    help
        Enable Dan's CSRF driver.

if DAN_CSRF

config DAN_CSRF_INIT_PRIORITY
    int "CSRF init priority"
    default 95
    help
        CSRF initialisation priority.

config DAN_CSRF_RX_BUFFER_SIZE
    int "CSRF RX buffer size"
    default 256
    help
        CSRF RX buffer for octets from radio before processing.

config DAN_CSRF_THREAD_STACK_SIZE
    int "CSRF thread stack size"
    default 1024
    help
        CSRF thread stack size.

config DAN_CSRF_THREAD_PRIORITY
  int "Thread priority for CSRF processing thread."
  default 10

module = DAN_CSRF
module-str = dan_csrf
source "subsys/logging/Kconfig.template.log_config"

endif
```

## zephyr-workspace/firmware/drivers/sensor/lsm6ds3/Kconfig
```kconfig
config USE_STDC_LSM6DS3TR_C
  bool

menuconfig SENSOR_LSM6DS3
  bool "ST LSM6DS3 accelerometer and gyro sensor driver"
  default y
  depends on DT_HAS_ST_LSM6DS3_ENABLED
  depends on ZEPHYR_HAL_ST_MODULE
  select I2C if $(dt_compat_on_bus,$(DT_COMPAT_ST_LSM6DS3),i2c)
  select SPI if $(dt_compat_on_bus,$(DT_COMPAT_ST_LSM6DS3),spi)
  select HAS_STMEMSC
  select USE_STDC_LSM6DS3TR_C
  help
    Enable support for ST's LSM6DS3 iNEMO 6DoF inertial measurement unit.
```
